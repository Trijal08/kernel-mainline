// SPDX-License-Identifier: GPL-2.0-only
/*
 * Wireless for the boards that carry the Broadcom BCM4390 combo chip:
 * caiman, komodo, tokay and comet (tegu uses a different part).
 *
 * Copyright 2025 Trijal Saha - <trijalsaha2012@gmail.com>
 */

#include <dt-bindings/gpio/gpio.h>

/* PCIe channel 1 (HSI2) connects to the Broadcom BCM4390 Wi-Fi. */
&pcie_1_phy {
	status = "okay";
};

&pcie_1 {
	pinctrl-0 = <&pcie1_clkreq &pcie1_perst>;
	pinctrl-names = "default";
	reset-gpios = <&gph3 0 GPIO_ACTIVE_HIGH>;	/* PERST */
	wlan-reg-on-gpios = <&gph3 4 GPIO_ACTIVE_HIGH>;	/* WLAN_EN */
	/* Out-of-band wake lines for the BCM4390 endpoint: WL_HOST_WAKE is the
	 * device-to-host interrupt (the dongle has no usable in-band D2H
	 * doorbell), WL_DEV_WAKE lets the host wake the dongle from deep sleep.
	 */
	host-wake-gpios = <&gpa5 3 GPIO_ACTIVE_HIGH>;	/* WL_HOST_WAKE */
	device-wake-gpios = <&gph3 5 GPIO_ACTIVE_HIGH>;	/* WL_DEV_WAKE */
	status = "okay";
};
