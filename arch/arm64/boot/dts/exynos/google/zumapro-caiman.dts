// SPDX-License-Identifier: GPL-2.0-only
/*
 * Pixel 9 Pro (caiman) Device Tree
 *
 * Copyright 2025 Trijal Saha - <trijalsaha2012@gmail.com>
 */

/dts-v1/;

#include "zumapro-pixel-common.dtsi"

/ {
	model = "Pixel 9 Pro";
	compatible = "google,caiman", "google,zumapro-caiman", "google,zumapro";
};

&cont_splash_mem {
	// reg = <0x0 0xfac00000 (1440 * 3120 * 4)>;
	reg = <0x0 0xfac00000 (1280 * 2856 * 4)>;
	status = "okay";
};

&framebuffer0 {
	// width = <1440>;
	// height = <3120>;
	// stride = <(1440 * 4)>;
	width = <1280>;
	height = <2856>;
	stride = <(1280 * 4)>;
	format = "a8r8g8b8";
	status = "okay";
};

&spitouch {
	st,dchip_id = /bits/ 8 <0x36 0x48>;
	st,max-coords = <1079 2399>;
	st,udfps-coords = <540 1769>;
	st,touch_offload_id = /bits/ 8 <'0' '0' 'o' '6'>;
};
