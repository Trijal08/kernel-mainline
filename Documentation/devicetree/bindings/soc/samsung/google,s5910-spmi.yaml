## Documentation/devicetree/bindings/soc/samsung/google,s5910-spmi.yaml
```yaml
# SPDX-License-Identifier: (GPL-2.0-only OR BSD-2-Clause)
%YAML 1.2
---
$id: http://devicetree.org/schemas/soc/samsung/google,s5910-spmi.yaml#
$schema: http://devicetree.org/meta-schemas/core.yaml#

title: Samsung S5910 DCXO clock buffer on SPMI

maintainers:
  - Trijal Saha <trijalsaha2012@gmail.com>

description:
  The S5910 DCXO clock buffer that feeds the Exynos modem (CP), an SPMI slave.
  It has no dedicated driver; the CP power sequencer (google,exynos-cp-power)
  reaches it over SPMI to program its turn-on sequence (LPM off) while the CP is
  held in reset, so the buffer survives the CP's autonomous sleep.

properties:
  compatible:
    const: google,s5910-spmi

  reg:
    maxItems: 1

required:
  - compatible
  - reg

additionalProperties: false

examples:
  - |
    #include <dt-bindings/spmi/spmi.h>

    spmi {
        #address-cells = <2>;
        #size-cells = <0>;

        clock-buffer@5 {
            compatible = "google,s5910-spmi";
            reg = <5 SPMI_USID>;
        };
    };
```

## Documentation/devicetree/bindings/spmi/google,bitbang-spmi-controller.yaml
```yaml
# SPDX-License-Identifier: (GPL-2.0-only OR BSD-2-Clause)
%YAML 1.2
---
$id: http://devicetree.org/schemas/spmi/google,bitbang-spmi-controller.yaml#
$schema: http://devicetree.org/meta-schemas/core.yaml#

title: Google GPIO bit-banged SPMI controller

maintainers:
  - Trijal Saha <trijalsaha2012@gmail.com>

description:
  A single-master SPMI bus bit-banged over two GPIOs (SCLK and SDATA).  It
  reaches a PMIC wired to a bare GPIO pair rather than a dedicated SPMI
  controller block, such as the Exynos modem CP PMIC on Tensor (gs/zuma)
  platforms.  Unlike a memory-mapped controller it has no register space, so
  the node carries no reg and is not named with a unit address.  Child nodes
  are SPMI slaves addressed as described in spmi.yaml.

properties:
  $nodename:
    pattern: "^spmi(-[0-9]+)?$"

  compatible:
    const: google,bitbang-spmi-controller

  "#address-cells":
    const: 2

  "#size-cells":
    const: 0

  sclk-gpios:
    maxItems: 1
    description: SPMI serial clock (SCLK) line.

  sdata-gpios:
    maxItems: 1
    description: SPMI serial data (SDATA) line.

  delay-us:
    default: 10
    description:
      Delay held for each clock phase, in microseconds; the bus runs at
      roughly 1 / (2 * delay-us).

patternProperties:
  "@[0-9a-f]$":
    type: object
    description: An SPMI slave device.  See spmi.yaml.

required:
  - compatible
  - "#address-cells"
  - "#size-cells"
  - sclk-gpios
  - sdata-gpios

additionalProperties: false

examples:
  - |
    #include <dt-bindings/gpio/gpio.h>
    #include <dt-bindings/spmi/spmi.h>

    spmi {
        compatible = "google,bitbang-spmi-controller";
        #address-cells = <2>;
        #size-cells = <0>;
        sclk-gpios = <&gpa3 2 GPIO_ACTIVE_HIGH>;
        sdata-gpios = <&gpa3 3 GPIO_ACTIVE_HIGH>;
        delay-us = <10>;

        pmic@0 {
            reg = <0 SPMI_USID>;
        };
    };
```

## Documentation/devicetree/bindings/timer/samsung,exynos-mct-v3.yaml
```yaml
# SPDX-License-Identifier: GPL-2.0
%YAML 1.2
---
$id: http://devicetree.org/schemas/timer/samsung,exynos-mct-v3.yaml#
$schema: http://devicetree.org/meta-schemas/core.yaml#

title: Samsung Exynos SoC Multi Core Timer (MCT) v3

maintainers:
  - Krzysztof Kozlowski <krzk@kernel.org>

description: |
  The v3 Multi Core Timer found on Google Tensor (Zuma/Zumapro) SoCs provides a
  64-bit free-running counter and a set of per-CPU comparators living in the
  always-on power block.  Unlike the older exynos4210-mct global/local timer
  layout it has no global comparator; each comparator raises its own per-CPU
  interrupt.  Because the comparators keep counting across CPU power-down idle
  states they can be used as the always-on per-CPU tick.

properties:
  compatible:
    const: samsung,exynos-mct-v3

  reg:
    maxItems: 1

  clocks:
    maxItems: 2

  clock-names:
    items:
      - const: fin_pll
      - const: mct

  interrupts:
    description:
      One interrupt per comparator, in comparator-index order; the driver uses
      one comparator per possible CPU.
    minItems: 1
    maxItems: 12

  div:
    $ref: /schemas/types.yaml#/definitions/uint32
    description:
      Divider applied to the input clock to derive the free-running counter
      rate.  Defaults to 3 when absent.

required:
  - compatible
  - reg
  - clocks
  - clock-names
  - interrupts

additionalProperties: false

examples:
  - |
    #include <dt-bindings/clock/google,zumapro.h>
    #include <dt-bindings/interrupt-controller/arm-gic.h>

    timer@100d0000 {
        compatible = "samsung,exynos-mct-v3";
        reg = <0x100d0000 0x800>;
        clocks = <&ext_24_5m>, <&cmu_misc CLK_GOUT_MISC_MCT_PCLK>;
        clock-names = "fin_pll", "mct";
        interrupts = <GIC_SPI 758 IRQ_TYPE_LEVEL_HIGH 0>,
                     <GIC_SPI 759 IRQ_TYPE_LEVEL_HIGH 0>,
                     <GIC_SPI 760 IRQ_TYPE_LEVEL_HIGH 0>,
                     <GIC_SPI 761 IRQ_TYPE_LEVEL_HIGH 0>,
                     <GIC_SPI 762 IRQ_TYPE_LEVEL_HIGH 0>,
                     <GIC_SPI 763 IRQ_TYPE_LEVEL_HIGH 0>,
                     <GIC_SPI 764 IRQ_TYPE_LEVEL_HIGH 0>,
                     <GIC_SPI 765 IRQ_TYPE_LEVEL_HIGH 0>,
                     <GIC_SPI 766 IRQ_TYPE_LEVEL_HIGH 0>;
        div = <1>;
    };
```
