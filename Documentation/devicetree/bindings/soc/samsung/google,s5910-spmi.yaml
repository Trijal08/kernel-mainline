## drivers/iio/common/aoc_usf/Kconfig
```kconfig
# SPDX-License-Identifier: GPL-2.0-only
config AOC_USF_IIO
	tristate "AoC USF sensor framework to IIO bridge"
	depends on IIO
	depends on GOOGLE_AOC_USF
	select IIO_BUFFER
	select IIO_KFIFO_BUF
	help
	  Bridge the sensors hosted by the AoC USF (Unified Sensor Framework)
	  firmware on Google Tensor devices to Linux IIO.  The driver loads the
	  sensor registry itself, out of the firmware search path, then
	  enumerates the sensors over the com.google.usf AOCC channel and
	  exposes them as IIO devices (accelerometer, gyroscope, magnetometer,
	  light, proximity, pressure).

	  To compile this driver as a module, choose M here: the module will
	  be called aoc-usf-iio.

	  If unsure, say N.
```

## drivers/media/platform/samsung/zumapro-ispfe/Kconfig
```kconfig
# SPDX-License-Identifier: GPL-2.0-only

config VIDEO_ZUMAPRO_ISPFE
	tristate "Google zumapro (Tensor G4) camera front end"
	depends on V4L_PLATFORM_DRIVERS
	depends on VIDEO_DEV && OF
	depends on ARCH_EXYNOS || COMPILE_TEST
	select MEDIA_CONTROLLER
	select VIDEO_V4L2_SUBDEV_API
	select VIDEOBUF2_DMA_CONTIG
	select V4L2_FWNODE
	help
	  MIPI CSI-2 DC-PHY, CSIS link and ISPFE Bayer WDMA of the Google
	  Tensor G4 SoC, as a raw capture device fed straight from the sensor.

	  To compile this driver as a module, choose M here: the module will
	  be called zumapro-ispfe.
```

## drivers/misc/qm35/Kconfig
```kconfig
# SPDX-License-Identifier: GPL-2.0-only
config QM35_SPI
	tristate "Qorvo QM35 UWB transceiver (HSSPI, UCI char device)"
	depends on SPI && GPIOLIB
	help
	  Transport driver for the Qorvo QM35xx UWB transceiver attached over
	  SPI. It exposes the chip's UCI (UWB Command Interface) as /dev/uci
	  and handles firmware flashing, logging and coredump retrieval.

	  Say M here to build this driver as a module named qm35.
```

## drivers/soc/google/Kconfig
```kconfig
# SPDX-License-Identifier: GPL-2.0-only
#
# Google SoC drivers
#

config GOOGLE_AOC
	tristate "Google AOC (Always-On Compute) coprocessor"
	depends on EXYNOS_GSA
	help
	  The AOC is an always-on coprocessor on Google Tensor SoCs that owns
	  Bluetooth, audio and the sensor hub.  The GSA security core
	  authenticates its firmware, so the driver needs it.

	  Releasing the core from reset is secure and needs one of the boot
	  backends below.  Without one the driver stages and authenticates the
	  image but cannot start the core.

	  This can be built as a module, which will be called aoc.

config GOOGLE_AOC_TRUSTY
	bool "Start the AOC through the Trusty GSA hardware manager"
	depends on GOOGLE_AOC
	depends on TRUSTY = y || TRUSTY = GOOGLE_AOC
	default y
	help
	  Bring the AOC out of reset with the GSA hardware-manager Trusty
	  application, which programs the core's secure SysMMU context and
	  then releases it.  This is how a stock device starts the AOC, and
	  the mailbox the GSA authenticates the image over cannot do it.

	  Say Y unless you have another way to start the core.

config GOOGLE_AOC_CHANNEL
	tristate "AoC channelized comms (AOCC) in-kernel client"
	depends on GOOGLE_AOC
	help
	  AOCC multiplexes many logical channels over one AOC service.  This
	  provides the in-kernel client used by the sensor hub (USF) and the
	  touch bus negotiator; there is no userspace char device, because
	  those stacks run entirely in the kernel.

	  This can be built as a module, which will be called aoc-channel.

config GOOGLE_AOC_USF
	tristate "Google AoC USF (Unified Sensor Framework) client"
	depends on GOOGLE_AOC_CHANNEL
	help
	  Client session for the sensor-hub firmware running on the AOC: the
	  AOCC transport, the request/response transactions, server-handle
	  resolution, sensor enumeration and sampling control.  Consumers add
	  the policy -- the IIO bridge and the wake-gesture input driver.

	  This can be built as a module, which will be called aoc-usf.
```

## drivers/tee/trusty/Kconfig
```kconfig
# SPDX-License-Identifier: GPL-2.0-only
#
# Trusty TEE
#

config TRUSTY
	tristate "Trusty TEE support"
	depends on TEE
	depends on ARM || ARM64
	depends on HAVE_ARM_SMCCC
	help
	  Trusty is a secure OS that runs in the ARM TrustZone secure world,
	  reached from the normal world through SMC calls.  This is the core
	  driver: it owns the SMC interface and exposes the fast- and
	  standard-call primitives the rest of the Trusty stack builds on.

	  Say Y here if your platform ships the Trusty secure OS and you need
	  the kernel to talk to it (for example to reach a Trusty-hosted
	  security service).  If unsure, say N.
```

## drivers/thermal/samsung/Kconfig
```kconfig
# SPDX-License-Identifier: GPL-2.0-only
config EXYNOS_THERMAL
	tristate "Exynos thermal management unit driver"
	depends on THERMAL_OF
	depends on HAS_IOMEM
	default ARCH_EXYNOS
	help
	  If you say yes here you get support for the TMU (Thermal Management
	  Unit) driver for Samsung Exynos series of SoCs. This driver initialises
	  the TMU, reports temperature and handles cooling action if defined.
	  This driver uses the Exynos core thermal APIs and TMU configuration
	  data from the supported SoCs.

config ZUMAPRO_ACPM_TMU
	tristate "Google Tensor (zumapro) ACPM TMU thermal sensor"
	depends on THERMAL_OF
	depends on EXYNOS_ACPM_PROTOCOL
	help
	  Thermal sensor driver for the Thermal Management Unit on the Google
	  Tensor G4 (zumapro) SoC.  The TMU is owned by the ACPM firmware, so
	  this driver reads per-zone temperatures over ACPM IPC and exposes them
	  as read-only thermal zones (and, with CONFIG_THERMAL_HWMON, hwmon
	  inputs).  It programs no trip points and leaves the firmware's own
	  thermal protection in place.
```

## sound/soc/google/Kconfig
```kconfig
# SPDX-License-Identifier: GPL-2.0-only
menu "Google"

config SND_SOC_CHV3_I2S
	tristate "Google Chameleon v3 I2S device"
	help
	  Enable support for the Google Chameleon v3 I2S device.

config SND_SOC_GOOGLE_AOC
	tristate "Google AOC coprocessor audio"
	depends on GOOGLE_AOC
	help
	  ASoC platform and card for the Google AOC (Always-On Compute)
	  coprocessor found on Tensor SoCs.  The AOC does the audio DSP and
	  drives the amplifiers; this streams PCM to it over its audio IPC
	  rings.  Say M here if you have an AOC and want AOC-routed audio.

config SND_SOC_EXYNOS_DP_DMA
	tristate "Exynos DisplayPort audio DMA front end"
	depends on DRM_EXYNOS9_DP
	select SND_SOC_GENERIC_DMAENGINE_PCM
	help
	  CPU DAI that feeds the Exynos DisplayPort link's audio FIFO through a
	  PL330 channel. Pair it with the hdmi-codec the DP bridge registers
	  via simple-audio-card.

endmenu
```
