## Documentation/devicetree/bindings/gnss/samsung,kepler.yaml
```yaml
# SPDX-License-Identifier: (GPL-2.0-only OR BSD-2-Clause)
%YAML 1.2
---
$id: http://devicetree.org/schemas/gnss/samsung,kepler.yaml#
$schema: http://devicetree.org/meta-schemas/core.yaml#

title: Samsung KEPLER GNSS receiver

maintainers:
  - Trijal Saha <trijalsaha2012@gmail.com>

description:
  The Samsung "KEPLER" GNSS receiver is the navigation companion of the Exynos
  CP (baseband) on Google Tensor SoCs. Its firmware is staged into CP shared
  memory and booted by the modem; the runtime host link is a dedicated SPI bus
  with a two-wire ready handshake.

allOf:
  - $ref: gnss-common.yaml#
  - $ref: /schemas/spi/spi-peripheral-props.yaml#

properties:
  compatible:
    const: samsung,kepler

  reg:
    maxItems: 1

  gnss2ap-gpios:
    maxItems: 1
    description:
      Receiver-to-host line. Driven high while the receiver has data to move
      or, during a host-initiated write, once it is ready to accept the
      transfer. This line is also the interrupt source.

  ap2gnss-gpios:
    maxItems: 1
    description:
      Host-to-receiver line, asserted by the host to signal that it is ready.

  # Receiver configuration.  The vendor keeps these in /vendor/etc/gnss/gps.cfg
  # and its daemon writes them into the firmware's configuration block before
  # the modem stages it; here they are properties so each board can state its
  # own.  A property left out keeps the value named below, except for the two
  # the modem decides, which keep whatever the modem driver uses.

  samsung,rf-misc-ctrl:
    $ref: /schemas/types.yaml#/definitions/uint32
    description: RF front-end miscellaneous control word.
    default: 2147516417

  samsung,aiding-configuration:
    $ref: /schemas/types.yaml#/definitions/uint32
    description: Which aiding sources the receiver may use.
    default: 131142

  samsung,mems-data-configuration:
    $ref: /schemas/types.yaml#/definitions/uint32
    description: Format and rate of the MEMS samples the host feeds in.
    default: 37

  samsung,gnss-const-constraint:
    $ref: /schemas/types.yaml#/definitions/uint32
    description: Bitmap of the constellations and bands the receiver may track.
    maximum: 65535
    default: 24831

  samsung,feature-cfg-set:
    $ref: /schemas/types.yaml#/definitions/uint32
    description: Feature bits to set in the word the firmware image ships.
    default: 1025

  samsung,feature-cfg-clear:
    $ref: /schemas/types.yaml#/definitions/uint32
    description: Feature bits to clear in that word.
    default: 2

  samsung,ref-clk-control:
    $ref: /schemas/types.yaml#/definitions/uint32
    description: Reference-clock source and buffer selection.
    maximum: 255
    default: 36

  samsung,scheduling-enabled:
    $ref: /schemas/types.yaml#/definitions/uint32
    description: Enable the receiver's internal measurement scheduler.
    default: 1

  samsung,dcxo-crystal-type:
    $ref: /schemas/types.yaml#/definitions/uint32
    description: Crystal fitted to the DCXO.
    maximum: 255
    default: 1

  samsung,path-delay-gps-2fx-cm:
    $ref: /schemas/types.yaml#/definitions/uint32
    description: GPS L1 antenna path delay, centimetres in 2.2 fixed point.
    maximum: 65535

  samsung,path-delay-bds-4fx-cm:
    $ref: /schemas/types.yaml#/definitions/uint32
    description: BeiDou antenna path delay, centimetres in 4.4 fixed point.
    maximum: 65535

  samsung,path-delay-l5-20fx-cm:
    $ref: /schemas/types.yaml#/definitions/uint32
    description: L5 antenna path delay, centimetres in 20.12 fixed point.

  samsung,mailbox-disabled:
    $ref: /schemas/types.yaml#/definitions/uint32
    description: Leave the receiver's mailbox interface shut down.
    default: 0

  samsung,vdr-high-end-distance:
    $ref: /schemas/types.yaml#/definitions/uint32
    description: Vehicle dead reckoning, distance at the high end, metres.
    default: 200

  samsung,vdr-low-end-distance:
    $ref: /schemas/types.yaml#/definitions/uint32
    description: Vehicle dead reckoning, distance at the low end, metres.
    default: 200

  samsung,vdr-high-end-time:
    $ref: /schemas/types.yaml#/definitions/uint32
    description: Vehicle dead reckoning, time at the high end, seconds.
    default: 20

  samsung,vdr-low-end-time:
    $ref: /schemas/types.yaml#/definitions/uint32
    description: Vehicle dead reckoning, time at the low end, seconds.
    default: 20

  samsung,ubsan-opt:
    $ref: /schemas/types.yaml#/definitions/uint32
    description: Undefined-behaviour checking level in the receiver firmware.
    maximum: 255
    default: 2

  samsung,ntn-option:
    $ref: /schemas/types.yaml#/definitions/uint32
    description: Non-terrestrial network support level.
    default: 2

  samsung,spi-option:
    $ref: /schemas/types.yaml#/definitions/uint32
    description: Options for the receiver's own SPI controller.
    default: 0

  samsung,timemark-option:
    $ref: /schemas/types.yaml#/definitions/uint32
    description: Timemark pulse behaviour.
    maximum: 255
    default: 1

  samsung,hibernate-monitor-en:
    $ref: /schemas/types.yaml#/definitions/uint32
    description: Enable the hibernate monitor.
    default: 1

  samsung,custom-nav-options:
    $ref: /schemas/types.yaml#/definitions/uint32
    description: Vendor navigation-engine options.
    maximum: 255
    default: 1

  samsung,cn0-filter-mode:
    $ref: /schemas/types.yaml#/definitions/uint32
    description: Carrier-to-noise filter mode.
    maximum: 255
    default: 1

required:
  - compatible
  - reg
  - gnss2ap-gpios
  - ap2gnss-gpios

unevaluatedProperties: false

examples:
  - |
    #include <dt-bindings/gpio/gpio.h>

    spi {
        #address-cells = <1>;
        #size-cells = <0>;

        gnss@0 {
            compatible = "samsung,kepler";
            reg = <0>;
            spi-max-frequency = <3125000>;
            gnss2ap-gpios = <&gpa5 4 GPIO_ACTIVE_HIGH>;
            ap2gnss-gpios = <&gpp2 3 GPIO_ACTIVE_HIGH>;
        };
    };
```

## Documentation/devicetree/bindings/input/cirrus,cs40l26.yaml
```yaml
# SPDX-License-Identifier: GPL-2.0-only OR BSD-2-Clause
%YAML 1.2
---
$id: http://devicetree.org/schemas/input/cirrus,cs40l26.yaml#
$schema: http://devicetree.org/meta-schemas/core.yaml#

title: Cirrus Logic CS40L26 Boosted Haptic Driver

maintainers:
  - Trijal Saha <trijalsaha2012@gmail.com>

description:
  CS40L26 is a boosted haptic driver with waveform memory, an integrated
  DSP and closed-loop algorithms. The part boots a firmware held in ROM,
  which the driver then replaces with a RAM patch and a waveform table.

properties:
  compatible:
    enum:
      - cirrus,cs40l26a
      - cirrus,cs40l26b
      - cirrus,cs40l27a
      - cirrus,cs40l27b

  reg:
    maxItems: 1

  interrupts:
    maxItems: 1

  reset-gpios:
    maxItems: 1

  vdd-a-supply:
    description: Power supply for internal analog circuits.

  vdd-p-supply:
    description: Power supply for the boost converter and always-on circuits.

required:
  - compatible
  - reg
  - interrupts
  - reset-gpios

additionalProperties: false

examples:
  - |
    #include <dt-bindings/gpio/gpio.h>
    #include <dt-bindings/interrupt-controller/irq.h>

    i2c {
      #address-cells = <1>;
      #size-cells = <0>;

      haptics@43 {
        compatible = "cirrus,cs40l26a";
        reg = <0x43>;
        interrupts-extended = <&gpio 3 IRQ_TYPE_LEVEL_LOW>;
        reset-gpios = <&gpio 11 GPIO_ACTIVE_LOW>;
      };
    };
```

## Documentation/devicetree/bindings/input/touchscreen/syna,tcm-spi.yaml
```yaml
# SPDX-License-Identifier: (GPL-2.0-only OR BSD-2-Clause)
%YAML 1.2
---
$id: http://devicetree.org/schemas/input/touchscreen/syna,tcm-spi.yaml#
$schema: http://devicetree.org/meta-schemas/core.yaml#

title: Synaptics TouchComm (TCM) SPI touchscreen controller

maintainers:
  - Steffen Deusch <steffen@deusch.me>

description:
  Synaptics touchscreen controllers speaking the TouchComm protocol
  version 2 over SPI, as found on Google Pixel phones.  The controller
  runs its firmware from internal flash and reports its panel geometry
  through the protocol, so no panel-specific properties are needed.

allOf:
  - $ref: touchscreen.yaml#
  - $ref: /schemas/spi/spi-peripheral-props.yaml#

properties:
  compatible:
    const: syna,tcm-spi

  reg:
    maxItems: 1

  interrupts:
    maxItems: 1

  reset-gpios:
    maxItems: 1
    description: Active-low reset line.

  vdd-supply:
    description: Digital I/O voltage rail (1.8 V).

  avdd-supply:
    description: Analog voltage rail (3.3 V).

  spi-max-frequency: true

required:
  - compatible
  - reg
  - interrupts
  - reset-gpios
  - vdd-supply
  - avdd-supply

unevaluatedProperties: false

examples:
  - |
    #include <dt-bindings/gpio/gpio.h>
    #include <dt-bindings/interrupt-controller/irq.h>

    spi {
        #address-cells = <1>;
        #size-cells = <0>;

        touchscreen@0 {
            compatible = "syna,tcm-spi";
            reg = <0>;
            spi-max-frequency = <10000000>;
            interrupts-extended = <&gpn0 0 IRQ_TYPE_LEVEL_LOW>;
            reset-gpios = <&gpp1 1 GPIO_ACTIVE_LOW>;
            vdd-supply = <&ts_vdd>;
            avdd-supply = <&ts_avdd>;
        };
    };
```

## Documentation/devicetree/bindings/interconnect/google,zumapro-bts.yaml
```yaml
# SPDX-License-Identifier: (GPL-2.0-only OR BSD-2-Clause)
%YAML 1.2
---
$id: http://devicetree.org/schemas/interconnect/google,zumapro-bts.yaml#
$schema: http://devicetree.org/meta-schemas/core.yaml#

title: Google Zumapro Bus Traffic Shaper

maintainers:
  - Steffen Deusch <steffen@deusch.me>

description: |
  The Samsung Bus Traffic Shaper (BTS) in Google's Zumapro SoC controls AXI
  quality of service at individual NoC masters and translates aggregate client
  bandwidth into minimum MIF and INT ACPM DVFS rates.

  The register resources describe the BTS blocks managed by this provider.
  Initially these are the two MFC memory ports. Client bandwidth and workload
  tags select per-master clock floors and outstanding-transaction profiles.

properties:
  compatible:
    const: google,zumapro-bts

  reg:
    items:
      - description: MFC channel 0 BTS registers
      - description: MFC channel 1 BTS registers

  reg-names:
    items:
      - const: mfc0
      - const: mfc1

  clocks:
    items:
      - description: MIF ACPM DVFS domain
      - description: INT ACPM DVFS domain

  clock-names:
    items:
      - const: mif
      - const: int

  '#interconnect-cells':
    const: 1

required:
  - compatible
  - reg
  - reg-names
  - clocks
  - clock-names
  - '#interconnect-cells'

additionalProperties: false

examples:
  - |
    #include <dt-bindings/clock/google,zumapro-acpm.h>

    interconnect@26c48380 {
        compatible = "google,zumapro-bts";
        reg = <0x26c48380 0x80>, <0x26c48400 0x80>;
        reg-names = "mfc0", "mfc1";
        clocks = <&acpm_ipc ZUMAPRO_CLK_ACPM_DVFS_MIF>,
                 <&acpm_ipc ZUMAPRO_CLK_ACPM_DVFS_INT>;
        clock-names = "mif", "int";
        #interconnect-cells = <1>;
    };
```

## Documentation/devicetree/bindings/interrupt-controller/google,zuma-vgpio2ap.yaml
```yaml
# SPDX-License-Identifier: (GPL-2.0-only OR BSD-2-Clause)
%YAML 1.2
---
$id: http://devicetree.org/schemas/interrupt-controller/google,zuma-vgpio2ap.yaml#
$schema: http://devicetree.org/meta-schemas/core.yaml#

title: Google Tensor VGPIO2AP interrupt demultiplexer

maintainers:
  - Trijal Saha <trijalsaha2012@gmail.com>

description: >
  The PMICs on Google Tensor boards sit on an I3C bus and raise in-band
  interrupts rather than driving a wire. The SoC presents those to the AP as a
  single shared interrupt together with two registers: a latch, which says that
  an in-band interrupt arrived and is cleared by writing it back, and a monitor
  word in the I3C block, whose first byte carries one bit per slave and so says
  which of them raised it.

  Despite the name nothing here is a GPIO - there is no line to read a level
  from and none to drive - so this is described as what it is, an interrupt
  controller that demultiplexes one parent interrupt into one child per slave.

properties:
  compatible:
    enum:
      - google,zuma-vgpio2ap

  reg:
    items:
      - description: the pending latch, in the VGPIO2AP sysreg block
      - description: the receive monitor, in the I3C block

  reg-names:
    items:
      - const: ipend
      - const: monitor

  interrupts:
    maxItems: 1
    description: the shared in-band interrupt from the I3C bus

  interrupt-controller: true

  "#interrupt-cells":
    const: 2
    description:
      The slave index, and the trigger flags. Index 0 is the main PMIC and
      index 1 the sub PMIC; the flags are accepted for consistency with other
      controllers and otherwise unused, since the trigger is a property of the
      bus rather than of anything programmable here.

required:
  - compatible
  - reg
  - reg-names
  - interrupts
  - interrupt-controller
  - "#interrupt-cells"

additionalProperties: false

examples:
  - |
    #include <dt-bindings/interrupt-controller/arm-gic.h>

    interrupt-controller@15090290 {
        compatible = "google,zuma-vgpio2ap";
        reg = <0x15090290 0x4>, <0x15501704 0x4>;
        reg-names = "ipend", "monitor";
        interrupt-controller;
        #interrupt-cells = <2>;
        interrupt-parent = <&gic>;
        interrupts = <GIC_SPI 74 IRQ_TYPE_LEVEL_HIGH 0>;
    };
```

## Documentation/devicetree/bindings/leds/ti,lm3644.yaml
```yaml
# SPDX-License-Identifier: (GPL-2.0-only OR BSD-2-Clause)
%YAML 1.2
---
$id: http://devicetree.org/schemas/leds/ti,lm3644.yaml#
$schema: http://devicetree.org/meta-schemas/core.yaml#

title: Texas Instruments LM3644 dual-channel flash LED controller

maintainers:
  - Linux LED Subsystem <linux-leds@vger.kernel.org>

description: |
  The LM3644 is a two-channel flash LED controller. Its outputs can drive
  separate LED components or be grouped to drive one logical flash LED.

properties:
  compatible:
    const: ti,lm3644

  reg:
    maxItems: 1

  enable-gpios:
    maxItems: 1
    description: Connection to the active-high HWEN pin.

  led:
    type: object
    $ref: common.yaml#
    unevaluatedProperties: false

    properties:
      led-sources:
        description:
          Output channels connected to the logical LED. Channel 0 denotes
          LED1 and channel 1 denotes LED2.
        minItems: 1
        maxItems: 2
        uniqueItems: true
        items:
          minimum: 0
          maximum: 1

      led-max-microamp:
        minimum: 977
        maximum: 360000

      flash-max-microamp:
        minimum: 10900
        maximum: 1500000

      flash-max-timeout-us:
        minimum: 10000
        maximum: 1600000

    required:
      - led-sources
      - led-max-microamp
      - flash-max-microamp
      - flash-max-timeout-us

required:
  - compatible
  - reg
  - enable-gpios
  - led

additionalProperties: false

examples:
  - |
    #include <dt-bindings/gpio/gpio.h>
    #include <dt-bindings/leds/common.h>

    i2c {
        #address-cells = <1>;
        #size-cells = <0>;

        led-controller@63 {
            compatible = "ti,lm3644";
            reg = <0x63>;
            enable-gpios = <&gpio 1 GPIO_ACTIVE_HIGH>;

            led {
                function = LED_FUNCTION_FLASH;
                color = <LED_COLOR_ID_WHITE>;
                led-sources = <0>, <1>;
                led-max-microamp = <90000>;
                flash-max-microamp = <750000>;
                flash-max-timeout-us = <100000>;
            };
        };
    };
```
