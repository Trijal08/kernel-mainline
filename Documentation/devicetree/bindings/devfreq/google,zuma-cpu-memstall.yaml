## Documentation/devicetree/bindings/phy/google,zuma-pcie-phy.yaml
```yaml
# SPDX-License-Identifier: (GPL-2.0-only OR BSD-2-Clause)
%YAML 1.2
---
$id: http://devicetree.org/schemas/phy/google,zuma-pcie-phy.yaml#
$schema: http://devicetree.org/meta-schemas/core.yaml#

title: Google Tensor SoC PCIe PHY

maintainers:
  - Trijal Saha <97483939+Trijal08@users.noreply.github.com>

description:
  PCIe PHY (Synopsys, Gen3) found on the Google Tensor SoCs (zuma/zumapro).
  The companion PCIe host controller (google,zuma-pcie) brackets the PHY
  init/power-on callbacks with its ELBI PMA-reset writes; the PHY itself
  programs the PMA/PCS banks and selects the external-PLL reference clock.

properties:
  compatible:
    const: google,zuma-pcie-phy

  reg:
    items:
      - description: PMA (PHY) registers.
      - description: PCS registers.
      - description: SoC control registers (PHY input-clock select).
      - description: micro-debug (external PLL) registers.

  reg-names:
    items:
      - const: phy
      - const: pcs
      - const: soc
      - const: udbg

  "#phy-cells":
    const: 0

  samsung,pmu-syscon:
    $ref: /schemas/types.yaml#/definitions/phandle
    description:
      Phandle to the PMU system controller that holds the PHY isolation bit.

  samsung,pmu-offset:
    $ref: /schemas/types.yaml#/definitions/uint32
    description:
      Offset of the PHY isolation control register within the PMU.

  num-lanes:
    const: 1

required:
  - compatible
  - reg
  - reg-names
  - "#phy-cells"
  - samsung,pmu-syscon
  - samsung,pmu-offset

additionalProperties: false

examples:
  - |
    phy@13160000 {
        compatible = "google,zuma-pcie-phy";
        reg = <0x13160000 0x3000>,
              <0x13140000 0x5000>,
              <0x13130000 0x5000>,
              <0x13150000 0xd000>;
        reg-names = "phy", "pcs", "soc", "udbg";
        samsung,pmu-syscon = <&pmu_system_controller>;
        samsung,pmu-offset = <0x3ec8>;
        num-lanes = <1>;
        #phy-cells = <0>;
    };
...
```

## Documentation/devicetree/bindings/phy/samsung,eusb2-repeater.yaml
```yaml
# SPDX-License-Identifier: (GPL-2.0-only OR BSD-2-Clause)
%YAML 1.2
---
$id: http://devicetree.org/schemas/phy/samsung,eusb2-repeater.yaml#
$schema: http://devicetree.org/meta-schemas/core.yaml#

title: Samsung eUSB2 to USB 2.0 repeater

maintainers:
  - Andrei Drimbarean <andreid021101@gmail.com>

description:
  eUSB2 repeater converts between eUSB2 and USB 2.0 signaling levels and
  allows an eUSB2 PHY to connect to legacy USB 2.0 products. The repeater
  sits on an I2C bus and is found on Google Tensor zuma/zumapro based
  boards, downstream of the SoC eUSB2 PHY.

properties:
  compatible:
    const: samsung,eusb-repeater

  reg:
    maxItems: 1

  "#phy-cells":
    const: 0

  vdd33-supply:
    description:
      Phandle to 3.3V regulator supply to the repeater.

  samsung,tune-param:
    $ref: /schemas/types.yaml#/definitions/uint32-matrix
    description:
      Board-specific signal tuning, expressed as a list of
      <register value> pairs that are programmed into the repeater over
      its I2C interface during initialization.
    minItems: 1
    items:
      items:
        - description: Repeater register offset
        - description: Value to program into the register

required:
  - compatible
  - reg
  - "#phy-cells"

additionalProperties: false

examples:
  - |
    i2c {
        #address-cells = <1>;
        #size-cells = <0>;

        eusb_repeater: phy@3e {
            compatible = "samsung,eusb-repeater";
            reg = <0x3e>;
            #phy-cells = <0>;
            vdd33-supply = <&reg_3p3>;
            samsung,tune-param = <0x50 0x0a>,
                                 <0x70 0x7c>,
                                 <0x71 0x3c>,
                                 <0x72 0x92>,
                                 <0x73 0x83>,
                                 <0x77 0x00>,
                                 <0x78 0x0b>,
                                 <0x79 0x60>;
        };
    };
...
```

## Documentation/devicetree/bindings/phy/samsung,exynos2200-eusb2-phy.yaml
```yaml
# SPDX-License-Identifier: (GPL-2.0 OR BSD-2-Clause)
%YAML 1.2
---
$id: http://devicetree.org/schemas/phy/samsung,exynos2200-eusb2-phy.yaml#
$schema: http://devicetree.org/meta-schemas/core.yaml#

title: Samsung Exynos2200 eUSB2 phy controller

maintainers:
  - Ivaylo Ivanov <ivo.ivanov.ivanov1@gmail.com>

description:
  Samsung Exynos2200 eUSB2 phy, based on Synopsys eUSB2 IP block, supports
  LS/FS/HS usb connectivity. The same IP block is used on Google Tensor
  zuma/zumapro SoCs, where the PHY drives an external eUSB2 to USB 2.0
  repeater.

properties:
  compatible:
    enum:
      - google,zuma-eusb2-phy
      - google,zumapro-eusb2-phy
      - samsung,exynos2200-eusb2-phy

  reg:
    maxItems: 1

  "#phy-cells":
    const: 0

  clocks:
    items:
      - description: Reference clock
      - description: Bus (APB) clock
      - description: Control clock

  clock-names:
    items:
      - const: ref
      - const: bus
      - const: ctrl

  resets:
    maxItems: 1

  power-domains:
    maxItems: 1

  phys:
    maxItems: 1
    description:
      Phandle to eUSB2 to USB 2.0 repeater

  samsung,ref-clock-frequency:
    $ref: /schemas/types.yaml#/definitions/uint32
    description:
      Effective reference clock frequency, in Hz, seen by the PHY on its
      reference clock pin. Used when the supplied "ref" clock models an
      undivided source (e.g. the PLL input) rather than the divided clock
      that actually reaches the PHY, so the driver cannot derive the rate
      from the clock framework alone.

  vdd-supply:
    description:
      Phandle to 0.88V regulator supply to PHY digital circuit.

  vdda12-supply:
    description:
      Phandle to 1.2V regulator supply to PHY refclk pll block.

required:
  - compatible
  - reg
  - "#phy-cells"
  - clocks
  - clock-names

allOf:
  - if:
      properties:
        compatible:
          contains:
            const: samsung,exynos2200-eusb2-phy
    then:
      required:
        - vdd-supply
        - vdda12-supply

additionalProperties: false

examples:
  - |
    usb_hsphy: phy@10ab0000 {
        compatible = "samsung,exynos2200-eusb2-phy";
        reg = <0x10ab0000 0x10000>;
        #phy-cells = <0>;

        clocks = <&cmu_hsi0 7>,
                 <&cmu_hsi0 5>,
                 <&cmu_hsi0 8>;
        clock-names = "ref", "bus", "ctrl";

        vdd-supply = <&vreg_0p88>;
        vdda12-supply = <&vreg_1p2>;
    };

  - |
    usb_hsphy2: phy@11110000 {
        compatible = "google,zuma-eusb2-phy";
        reg = <0x11110000 0x0200>;
        #phy-cells = <0>;

        clocks = <&cmu_hsi0 7>,
                 <&cmu_hsi0 5>,
                 <&cmu_hsi0 8>;
        clock-names = "ref", "bus", "ctrl";
        samsung,ref-clock-frequency = <19200000>;

        phys = <&eusb_repeater>;
        power-domains = <&pd_hsi0>;
    };
```

## Documentation/devicetree/bindings/power/pd-samsung.yaml
```yaml
# SPDX-License-Identifier: GPL-2.0
%YAML 1.2
---
$id: http://devicetree.org/schemas/power/pd-samsung.yaml#
$schema: http://devicetree.org/meta-schemas/core.yaml#

title: Samsung Exynos SoC Power Domains

maintainers:
  - Krzysztof Kozlowski <krzk@kernel.org>

description: |+
  Exynos processors include support for multiple power domains which are used
  to gate power to one or more peripherals on the processor.

allOf:
  - $ref: power-domain.yaml#
  - if:
      properties:
        compatible:
          const: google,zumapro-pd
    then:
      properties:
        reg-names:
          minItems: 1
    else:
      properties:
        reg:
          maxItems: 1
        reg-names: false
        samsung,always-on: false
        samsung,secure-pd-id: false

properties:
  compatible:
    enum:
      - google,zumapro-pd
      - samsung,exynos4210-pd
      - samsung,exynos5433-pd

  reg:
    minItems: 1
    items:
      - description: The domain's configuration and status registers in the PMU
      - description: |
          The register block of the clock controller (CMU) inside the domain.
          The power sequence writes its controller option before the domain
          goes down and, for a domain whose CMU has no clock provider, saves
          and restores its clock state around the transition.
      - description: |
          The register block of the system registers (SYSREG) inside the
          domain, saved and restored with the CMU.

  reg-names:
    minItems: 1
    items:
      - const: pmu
      - const: cmu
      - const: sysreg

  clocks:
    deprecated: true
    maxItems: 1

  clock-names:
    deprecated: true
    maxItems: 1

  label:
    description:
      Human readable string with domain name. Will be visible in userspace
      to let user to distinguish between multiple domains in SoC.

  "#power-domain-cells":
    const: 0

  power-domains:
    maxItems: 1

  samsung,always-on:
    type: boolean
    description:
      Keep the domain powered while Linux lacks complete save/restore
      sequencing for the domain.

  samsung,secure-pd-id:
    $ref: /schemas/types.yaml#/definitions/uint32
    description:
      Secure monitor power-domain identifier used by Tensor-class Exynos
      firmware before power-down and after power-up.

required:
  - compatible
  - "#power-domain-cells"
  - reg

unevaluatedProperties: false

examples:
  - |
    lcd0_pd: power-domain@10023c80 {
        compatible = "samsung,exynos4210-pd";
        reg = <0x10023c80 0x20>;
        #power-domain-cells = <0>;
        label = "LCD0";
    };

    mfc_pd: power-domain@10044060 {
        compatible = "samsung,exynos4210-pd";
        reg = <0x10044060 0x20>;
        #power-domain-cells = <0>;
        label = "MFC";
    };

  - |
    display_pd: power-domain@15461d00 {
        compatible = "google,zumapro-pd";
        reg = <0x15461d00 0x20>, <0x19400000 0x10000>;
        reg-names = "pmu", "cmu";
        samsung,secure-pd-id = <0x19410204>;
        samsung,always-on;
        #power-domain-cells = <0>;
        label = "DPUB";
    };
```

## Documentation/devicetree/bindings/power/supply/maxim,max77779fg.yaml
```yaml
# SPDX-License-Identifier: GPL-2.0-only OR BSD-2-Clause
%YAML 1.2
---
$id: http://devicetree.org/schemas/power/supply/maxim,max77779fg.yaml#
$schema: http://devicetree.org/meta-schemas/core.yaml#

title: Maxim MAX77779 ModelGauge m5 fuel gauge

maintainers:
  - Steffen Deusch <steffen@deusch.me>

description:
  The MAX77779 PMIC integrates a ModelGauge m5 fuel gauge that is reachable as
  an independent I2C device (default address 0x36). This binding describes the
  fuel-gauge function only.

allOf:
  - $ref: power-supply.yaml#

properties:
  compatible:
    const: maxim,max77779fg

  reg:
    maxItems: 1

  interrupts:
    maxItems: 1

  shunt-resistor-micro-ohms:
    description:
      Resistance of the battery current-sense resistor. Required for current
      and charge (capacity) readings; state-of-charge, voltage and temperature
      are reported regardless of its presence.

required:
  - compatible
  - reg

unevaluatedProperties: false

examples:
  - |
    i2c {
        #address-cells = <1>;
        #size-cells = <0>;

        fuel-gauge@36 {
            compatible = "maxim,max77779fg";
            reg = <0x36>;
            shunt-resistor-micro-ohms = <5000>;
        };
    };
```

## Documentation/devicetree/bindings/soc/samsung/google,cp-pmic-spmi.yaml
```yaml
# SPDX-License-Identifier: (GPL-2.0-only OR BSD-2-Clause)
%YAML 1.2
---
$id: http://devicetree.org/schemas/soc/samsung/google,cp-pmic-spmi.yaml#
$schema: http://devicetree.org/meta-schemas/core.yaml#

title: Google Exynos modem (CP) PMIC on SPMI

maintainers:
  - Trijal Saha <trijalsaha2012@gmail.com>

description:
  The Exynos modem (CP) PMIC, an SPMI slave.  It has no dedicated driver; the CP
  power sequencer (google,exynos-cp-power) reaches it over SPMI to re-apply a
  register patch after each CP PMIC reset.

properties:
  compatible:
    const: google,cp-pmic-spmi

  reg:
    maxItems: 1

required:
  - compatible
  - reg

additionalProperties: false

examples:
  - |
    #include <dt-bindings/spmi/spmi.h>

    spmi {
        #address-cells = <2>;
        #size-cells = <0>;

        pmic@0 {
            compatible = "google,cp-pmic-spmi";
            reg = <0 SPMI_USID>;
        };
    };
```

## Documentation/devicetree/bindings/soc/samsung/google,exynos-cp-power.yaml
```yaml
# SPDX-License-Identifier: (GPL-2.0-only OR BSD-2-Clause)
%YAML 1.2
---
$id: http://devicetree.org/schemas/soc/samsung/google,exynos-cp-power.yaml#
$schema: http://devicetree.org/meta-schemas/core.yaml#

title: Exynos modem (CP) power/reset sequencer

maintainers:
  - Trijal Saha <trijalsaha2012@gmail.com>

description:
  Sequences power and reset for the Exynos modem (CP) on Tensor (zuma/zumapro)
  platforms.  It owns the AP2CP rail GPIOs and drives the CP PMIC and the S5910
  DCXO clock buffer over SPMI, so the PCIe root complex that hosts the modem
  endpoint can delegate CP warm reset and cold power cycling to it.

properties:
  compatible:
    const: google,exynos-cp-power

  cp-pwr-gpios:
    maxItems: 1
    description: CP power enable (AP2CP_CP_PWR_ON).

  cp-nreset-gpios:
    maxItems: 1
    description: CP reset, active low (AP2CP_CP_NRESET_N).

  cp-pm-wrst-gpios:
    maxItems: 1
    description: CP PMIC warm reset (AP2CP_PM_WRST_N).

  cp-wrst-gpios:
    maxItems: 1
    description: CP warm reset (AP2CP_CP_WRST_N).

  cp-pda-active-gpios:
    maxItems: 1
    description: AP power-down acknowledge (AP2CP_PDA_ACTIVE).

  cp-dump-noti-gpios:
    maxItems: 1
    description: Crash-dump notification (AP2CP_DUMP_NOTI); cleared before reset.

  cp2ap-cp-wrst-gpios:
    maxItems: 1
    description: CP warm-reset acknowledge input (CP2AP_CP_WRST_N).

  google,cp-pmic:
    $ref: /schemas/types.yaml#/definitions/phandle
    description: Phandle to the CP PMIC SPMI device patched after a warm reset.

  google,cp-dcxo:
    $ref: /schemas/types.yaml#/definitions/phandle
    description: Phandle to the S5910 DCXO clock-buffer SPMI device.

required:
  - compatible
  - cp-pwr-gpios
  - cp-nreset-gpios
  - cp-pm-wrst-gpios
  - cp-wrst-gpios
  - cp-pda-active-gpios

additionalProperties: false

examples:
  - |
    #include <dt-bindings/gpio/gpio.h>

    cp-power {
        compatible = "google,exynos-cp-power";
        cp-pwr-gpios = <&gpp12 2 GPIO_ACTIVE_HIGH>;
        cp-nreset-gpios = <&gpp12 3 GPIO_ACTIVE_HIGH>;
        cp-pm-wrst-gpios = <&gpp8 3 GPIO_ACTIVE_HIGH>;
        cp-wrst-gpios = <&gpp16 3 GPIO_ACTIVE_HIGH>;
        cp-pda-active-gpios = <&gpp16 2 GPIO_ACTIVE_HIGH>;
        cp-dump-noti-gpios = <&gpp16 1 GPIO_ACTIVE_HIGH>;
        cp2ap-cp-wrst-gpios = <&gpa7 3 GPIO_ACTIVE_HIGH>;
        google,cp-pmic = <&cp_pmic>;
        google,cp-dcxo = <&cp_s5910>;
    };
```
