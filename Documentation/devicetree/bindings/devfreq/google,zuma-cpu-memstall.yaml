## Documentation/devicetree/bindings/devfreq/google,zuma-cpu-memstall.yaml
```yaml
# SPDX-License-Identifier: (GPL-2.0-only OR BSD-2-Clause)
%YAML 1.2
---
$id: http://devicetree.org/schemas/devfreq/google,zuma-cpu-memstall.yaml#
$schema: http://devicetree.org/meta-schemas/core.yaml#

title: Google Zuma CPU memory-stall bus frequency floor

maintainers:
  - Trijal Saha <trijalsaha2012@gmail.com>

description:
  The buses between the CPUs and memory on Zuma - the DSU and the BCI - are
  normally scaled from the CPU frequencies. That misses a core that is waiting
  on memory rather than running slowly, so this device samples the share of
  each CPU's cycles that is lost to a backend memory stall, as reported by the
  CPU's activity monitors, and raises a minimum-frequency floor on the listed
  bus devices while that share is above a threshold. The floor is dropped
  again as soon as the share falls back.

properties:
  compatible:
    const: google,zuma-cpu-memstall

  devfreq:
    $ref: /schemas/types.yaml#/definitions/phandle-array
    minItems: 1
    maxItems: 4
    description:
      The bus devfreq devices to hold a floor on. The order fixes the meaning
      of the columns in each cluster's google,freq-map-khz.

  google,sample-interval-us:
    default: 8000
    description:
      How often each CPU's monitors are sampled. Rounded up to a whole jiffy,
      and deferred while a CPU is idle.

patternProperties:
  '^cluster-[0-9]+$':
    type: object
    description:
      A group of CPUs that share a mapping. One node per cluster, as the
      mapping follows the CPU operating points.

    properties:
      cpus:
        $ref: /schemas/types.yaml#/definitions/phandle-array
        minItems: 1
        description: The CPUs in this cluster.

      google,mem-stall-threshold-permille:
        $ref: /schemas/types.yaml#/definitions/uint32
        minimum: 1
        maximum: 1000
        description:
          The share of a CPU's cycles that must be lost to a backend memory
          stall, in parts per thousand, before this cluster asks for a floor.

      google,freq-map-khz:
        $ref: /schemas/types.yaml#/definitions/uint32-matrix
        description:
          Rows of one CPU frequency followed by the floor each device in
          devfreq is asked for at or above it, all in kHz. Rows must be in
          ascending order of CPU frequency, and a CPU running below the first
          row asks for nothing. The CPU frequency is the one the core actually
          achieved over the sample window, so a partly idle core lands on a
          lower row than its current operating point.
        items:
          minItems: 2
          maxItems: 5

    required:
      - cpus
      - google,mem-stall-threshold-permille
      - google,freq-map-khz

    additionalProperties: false

required:
  - compatible
  - devfreq

additionalProperties: false

examples:
  - |
    cpu-memstall {
        compatible = "google,zuma-cpu-memstall";
        devfreq = <&bus_dsu>, <&bus_bci>;

        cluster-0 {
            cpus = <&cpu0>, <&cpu1>, <&cpu2>, <&cpu3>;
            google,mem-stall-threshold-permille = <175>;
            /*          CPU      DSU      BCI */
            google,freq-map-khz = < 820000  820000  840000>,
                                  < 955000  970000  951000>,
                                  <1098000 1197000 1205000>;
        };
    };
```

## Documentation/devicetree/bindings/display/panel/google,komodo.yaml
```yaml
# SPDX-License-Identifier: (GPL-2.0-only OR BSD-2-Clause)
%YAML 1.2
---
$id: http://devicetree.org/schemas/display/panel/google,komodo.yaml#
$schema: http://devicetree.org/meta-schemas/core.yaml#

title: Google Komodo (Pixel 9 Pro XL) MIPI-DSI panel

maintainers:
  - Trijal Saha <trijalsaha2012@gmail.com>

description:
  The komodo (Pixel 9 Pro XL, google,gs-km4) panel is a 1344x2992 command-mode
  LTPO OLED driven over 4-lane MIPI-DSI with dual DSC. The bootloader powers
  and lights the panel; this binding describes the boot-handoff use where the
  driver adopts the running link, so no power supplies or reset GPIO are
  described.

allOf:
  - $ref: panel-common.yaml#

properties:
  compatible:
    const: google,komodo-panel

  reg:
    maxItems: 1
    description: DSI virtual channel

  reset-gpios:
    maxItems: 1
    description:
      DDIC reset line, used for a cold power-on. Not required on a board that
      only ever adopts a bootloader-lit panel (boot handover).

  port: true

required:
  - compatible
  - reg
  - port

unevaluatedProperties: false

examples:
  - |
    dsi {
        #address-cells = <1>;
        #size-cells = <0>;

        panel@0 {
            compatible = "google,komodo-panel";
            reg = <0>;

            port {
                panel_in: endpoint {
                    remote-endpoint = <&dsim0_out>;
                };
            };
        };
    };
```

## Documentation/devicetree/bindings/display/panel/google,tk4c.yaml
```yaml
# SPDX-License-Identifier: (GPL-2.0-only OR BSD-2-Clause)
%YAML 1.2
---
$id: http://devicetree.org/schemas/display/panel/google,tk4c.yaml#
$schema: http://devicetree.org/meta-schemas/core.yaml#

title: Google TK4C MIPI-DSI panel

maintainers:
  - Trijal Saha <trijalsaha2012@gmail.com>

description:
  The TK4C is one of the 1080x2424 command-mode LTPO OLED panels used by
  Google Pixel 9 (tokay). It uses four MIPI-DSI lanes and dual DSC.

allOf:
  - $ref: panel-common.yaml#

properties:
  compatible:
    const: google,gs-tk4c

  reg:
    maxItems: 1
    description: DSI virtual channel

  reset-gpios:
    maxItems: 1

  port: true

required:
  - compatible
  - reg
  - reset-gpios
  - port

unevaluatedProperties: false

examples:
  - |
    dsi {
        #address-cells = <1>;
        #size-cells = <0>;

        panel@0 {
            compatible = "google,gs-tk4c";
            reg = <0>;
            reset-gpios = <&gpp0 0 0>;

            port {
                panel_in: endpoint {
                    remote-endpoint = <&dsim0_out>;
                };
            };
        };
    };
```

## Documentation/devicetree/bindings/display/samsung/google,zuma-decon.yaml
```yaml
# SPDX-License-Identifier: (GPL-2.0-only OR BSD-2-Clause)
%YAML 1.2
---
$id: http://devicetree.org/schemas/display/samsung/google,zuma-decon.yaml#
$schema: http://devicetree.org/meta-schemas/core.yaml#

title: Google Zuma/Zumapro SoC Display and Enhancement Controller (DECON)

maintainers:
  - Trijal Saha <trijalsaha2012@gmail.com>

description:
  DECON (Display and Enhancement Controller) is the display controller on the
  Google Tensor "zuma"/"zumapro" (G3/G4) SoCs. It reads a framebuffer, blends
  the enabled windows, optionally DSC-compresses the result and drives it to a
  MIPI-DSI (DSIM) output. It is programmed through the same Exynos9 core as
  Exynos Auto v9 but has a re-laid-out register map (four SFR blocks).

properties:
  compatible:
    const: google,zuma-decon

  reg:
    items:
      - description: DECON_MAIN register block
      - description: DECON_WIN (window control) register block
      - description: DECON_SUB (DSC / DSIMIF) register block
      - description: DECON_WINCON (window configuration) register block

  reg-names:
    items:
      - const: main
      - const: win
      - const: sub
      - const: wincon

  interrupts:
    minItems: 1
    items:
      - description: frame done
      - description: frame start
      - description: resource-conflict / timeout (extra)

  interrupt-names:
    minItems: 1
    items:
      - const: frame_done
      - const: frame_start
      - const: extra

  clocks:
    maxItems: 1

  clock-names:
    items:
      - const: aclk

  power-domains:
    maxItems: 1

  ports:
    $ref: /schemas/graph.yaml#/properties/ports
    properties:
      port@0:
        $ref: /schemas/graph.yaml#/properties/port
        description: Output to the DSIM (MIPI-DSI) encoder.

    required:
      - port@0

required:
  - compatible
  - reg
  - reg-names
  - interrupts
  - interrupt-names
  - clocks
  - clock-names
  - power-domains
  - ports

additionalProperties: false

examples:
  - |
    #include <dt-bindings/interrupt-controller/arm-gic.h>

    decon0: decon@19470000 {
        compatible = "google,zuma-decon";
        reg = <0x19470000 0x6000>,
              <0x19480000 0xe000>,
              <0x19490000 0x10000>,
              <0x194a0000 0xe000>;
        reg-names = "main", "win", "sub", "wincon";
        interrupts = <GIC_SPI 242 IRQ_TYPE_LEVEL_HIGH 0>,
                     <GIC_SPI 243 IRQ_TYPE_LEVEL_HIGH 0>,
                     <GIC_SPI 241 IRQ_TYPE_LEVEL_HIGH 0>;
        interrupt-names = "frame_done", "frame_start", "extra";
        clocks = <&cmu_dpu 12>;
        clock-names = "aclk";
        power-domains = <&pd_dpuf0>;

        ports {
            #address-cells = <1>;
            #size-cells = <0>;

            port@0 {
                reg = <0>;
                decon0_out: endpoint {
                    remote-endpoint = <&dsim0_in>;
                };
            };
        };
    };
```

## Documentation/devicetree/bindings/display/samsung/google,zuma-dsim.yaml
```yaml
# SPDX-License-Identifier: (GPL-2.0-only OR BSD-2-Clause)
%YAML 1.2
---
$id: http://devicetree.org/schemas/display/samsung/google,zuma-dsim.yaml#
$schema: http://devicetree.org/meta-schemas/core.yaml#

title: Google Zuma/Zumapro SoC MIPI DSIM

maintainers:
  - Trijal Saha <trijalsaha2012@gmail.com>

description:
  The MIPI-DSIM host on the Google Tensor "zuma"/"zumapro" SoCs. It is a new IP
  (DSIM_LINK + DCPHY) distinct from the earlier samsung-dsim. This binding
  describes the boot-handoff use, where the bootloader trains the DCPHY link
  and the driver adopts it to drive a command-mode DSC panel.

allOf:
  - $ref: /schemas/display/dsi-controller.yaml#

properties:
  compatible:
    const: google,zuma-dsim

  reg:
    items:
      - description: DSIM link registers
      - description: DCPHY registers
      - description: DCPHY extra registers

  reg-names:
    items:
      - const: dsi
      - const: dphy
      - const: dphy-extra

  interrupts:
    maxItems: 1

  clocks:
    maxItems: 1

  clock-names:
    items:
      - const: bus_clk

  power-domains:
    maxItems: 1

  te-gpios:
    maxItems: 1
    description:
      Panel tearing-effect GPIO routed into the DECON hardware trigger for
      command-mode operation.

  ports:
    $ref: /schemas/graph.yaml#/properties/ports
    properties:
      port@0:
        $ref: /schemas/graph.yaml#/properties/port
        description: Input from the DECON.
      port@1:
        $ref: /schemas/graph.yaml#/properties/port
        description: Output to the panel.

    required:
      - port@0

required:
  - compatible
  - reg
  - reg-names
  - interrupts
  - clocks
  - clock-names
  - power-domains
  - ports

unevaluatedProperties: false

examples:
  - |
    #include <dt-bindings/interrupt-controller/arm-gic.h>

    dsi@19440000 {
        compatible = "google,zuma-dsim";
        reg = <0x19440000 0x300>,
              <0x19450000 0x300>,
              <0x19460000 0x300>;
        reg-names = "dsi", "dphy", "dphy-extra";
        interrupts = <GIC_SPI 252 IRQ_TYPE_LEVEL_HIGH 0>;
        clocks = <&cmu_dpu 5>;
        clock-names = "bus_clk";
        power-domains = <&pd_dpuf0>;
        te-gpios = <&gpp0 3 0>;
        #address-cells = <1>;
        #size-cells = <0>;

        ports {
            #address-cells = <1>;
            #size-cells = <0>;

            port@0 {
                reg = <0>;
                dsim0_in: endpoint {
                    remote-endpoint = <&decon0_out>;
                };
            };

            port@1 {
                reg = <1>;
                dsim0_out: endpoint {
                    remote-endpoint = <&panel_in>;
                };
            };
        };
    };
```
