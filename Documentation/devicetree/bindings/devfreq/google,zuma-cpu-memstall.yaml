## Documentation/devicetree/bindings/media/google,zuma-bigwave.yaml
```yaml
# SPDX-License-Identifier: (GPL-2.0-only OR BSD-2-Clause)
%YAML 1.2
---
$id: http://devicetree.org/schemas/media/google,zuma-bigwave.yaml#
$schema: http://devicetree.org/meta-schemas/core.yaml#

title: Hantro G2 VPU codec on Google Zuma SoCs

maintainers:
  - Trijal Saha <trijalsaha2012@gmail.com>

description: >
  The video accelerator Google calls BigWave on its Zuma and Zuma Pro SoCs,
  used for AV1 and VP9 decoding. It is a Hantro G2 class core, exposing the
  same 4-byte-strided bank of swregs the other G2 cores do, with the hardware
  identifier, the control word and the status word at its front.

  The core has no clock of its own to name here. Its frequency follows the
  power domain, which the firmware scales, so there is nothing for a consumer
  to ask for.

properties:
  compatible:
    const: google,zuma-bigwave

  reg:
    maxItems: 1

  interrupts:
    maxItems: 1

  power-domains:
    maxItems: 1

  iommus:
    maxItems: 1

required:
  - compatible
  - reg
  - interrupts
  - power-domains

additionalProperties: false

examples:
  - |
    #include <dt-bindings/interrupt-controller/arm-gic.h>

    vpu: video-codec@1a700000 {
        compatible = "google,zuma-bigwave";
        reg = <0x1a700000 0x860>;
        interrupts = <GIC_SPI 523 IRQ_TYPE_LEVEL_HIGH>;
        power-domains = <&pd_bw>;
        iommus = <&sysmmu_bw>;
    };
```

## Documentation/devicetree/bindings/misc/qorvo,qm35.yaml
```yaml
# SPDX-License-Identifier: (GPL-2.0-only OR BSD-2-Clause)
%YAML 1.2
---
$id: http://devicetree.org/schemas/misc/qorvo,qm35.yaml#
$schema: http://devicetree.org/meta-schemas/core.yaml#

title: Qorvo QM35 Ultra-Wideband transceiver

maintainers:
  - Marcus Ramberg <marcus.ramberg@gmail.com>

description:
  The QM35 is an IEEE 802.15.4z UWB transceiver controlled over SPI with the
  FiRa UCI protocol.  It signals the host over two lines, SS_READY (it can
  accept a transfer) and SS_IRQ (it has data to deliver), and is woken by the
  host through a WAKEUP line.

allOf:
  - $ref: /schemas/spi/spi-peripheral-props.yaml#

properties:
  compatible:
    const: qorvo,qm35

  reg:
    maxItems: 1

  reset-gpios:
    maxItems: 1

  ready-gpios:
    maxItems: 1
    description: SS_READY, driven by the chip when it can accept a transfer

  irq-gpios:
    maxItems: 1
    description:
      SS_IRQ, driven by the chip when it has data for the host.  The host
      both takes an interrupt from it and polls its level, hence a GPIO.

  exton-gpios:
    maxItems: 1
    description: EXTON, driven high by the chip while it is powered and running

  wakeup-gpios:
    maxItems: 1
    description: WAKEUP, driven by the host to bring the chip out of sleep

  vdd1-supply: true
  vdd2-supply: true
  vdd3-supply: true
  vdd4-supply: true

required:
  - compatible
  - reg
  - ready-gpios
  - irq-gpios

unevaluatedProperties: false

examples:
  - |
    #include <dt-bindings/gpio/gpio.h>

    spi {
        #address-cells = <1>;
        #size-cells = <0>;

        uwb@0 {
            compatible = "qorvo,qm35";
            reg = <0>;
            spi-max-frequency = <20000000>;
            reset-gpios = <&gpp14 0 GPIO_ACTIVE_LOW>;
            ready-gpios = <&gpn4 0 GPIO_ACTIVE_HIGH>;
            irq-gpios = <&gpn5 0 GPIO_ACTIVE_HIGH>;
            exton-gpios = <&gpp13 1 GPIO_ACTIVE_HIGH>;
            wakeup-gpios = <&gpp15 1 GPIO_ACTIVE_HIGH>;
            vdd1-supply = <&uwb_1v8>;
            vdd2-supply = <&uwb_rf>;
        };
    };
```

## Documentation/devicetree/bindings/misc/st,st54spi.yaml
```yaml
# SPDX-License-Identifier: (GPL-2.0-only OR BSD-2-Clause)
%YAML 1.2
---
$id: http://devicetree.org/schemas/misc/st,st54spi.yaml#
$schema: http://devicetree.org/meta-schemas/core.yaml#

title: STMicroelectronics ST54 embedded secure element, SPI host interface

maintainers:
  - Marcus Ramberg <marcus.ramberg@gmail.com>

description:
  The ST54 NFC controllers carry an embedded secure element with its own SPI
  slave port.  The host exchanges ISO 7816 APDUs with it over that port; no
  kernel protocol is involved, so the device is used through spidev.

allOf:
  - $ref: /schemas/spi/spi-peripheral-props.yaml#

properties:
  compatible:
    const: st,st54spi

  reg:
    maxItems: 1

required:
  - compatible
  - reg

unevaluatedProperties: false

examples:
  - |
    spi {
        #address-cells = <1>;
        #size-cells = <0>;

        secure-element@0 {
            compatible = "st,st54spi";
            reg = <0>;
            spi-max-frequency = <8000000>;
            spi-cs-setup-delay-ns = <18000>;
        };
    };
```

## Documentation/devicetree/bindings/net/wwan/samsung,s5300-modem.yaml
```yaml
# SPDX-License-Identifier: (GPL-2.0-only OR BSD-2-Clause)
%YAML 1.2
---
$id: http://devicetree.org/schemas/net/wwan/samsung,s5300-modem.yaml#
$schema: http://devicetree.org/meta-schemas/core.yaml#

title: Samsung Exynos Modem 5300 (PCIe)

maintainers:
  - Steffen Deusch <steffen@deusch.me>

description:
  Discrete Samsung Exynos Modem 5300 companion chip attached over PCIe, as
  found on Google Tensor G4 (zumapro) boards.  The AP stages the first-stage
  CP bootloader in a DRAM carveout, publishes it through a second carveout
  that doubles as the PCIe MSI target, and completes a shared-memory command
  handshake.  Bring-up binding; the PCIe root-complex phandle and doorbell
  address will move behind generic abstractions as the driver grows up.

properties:
  compatible:
    const: samsung,s5300-modem

  memory-region:
    minItems: 2
    items:
      - description: IPC shared-memory carveout (boot image staging, command
          words and message queues)
      - description: MSI carveout the CP reports boot progress into
      - description: PKTPROC carveout the CP DMAs downlink packets into

  memory-region-names:
    minItems: 2
    items:
      - const: ipc
      - const: msi
      - const: pktproc

  firmware-name:
    maxItems: 1
    description: First-stage CP bootloader (the BOOT entry of the vendor
      modem image TOC).

  google,pcie:
    $ref: /schemas/types.yaml#/definitions/phandle
    description: PCIe root complex the modem is attached to.

  samsung,doorbell-addr:
    $ref: /schemas/types.yaml#/definitions/uint32
    description: PCI bus address programmed into the endpoint's BAR0; the
      doorbell register decodes there in both boot phases.

  cp2ap-wakeup-gpios:
    maxItems: 1
    description: CP-driven line signalling the CP is awake / ready to
      re-link.

  cp2ap-active-gpios:
    maxItems: 1
    description: CP2AP_PHONE_ACTIVE; high while the CP runs, a falling edge
      after ONLINE indicates a CP crash.  Optional (crash diagnosis).

  cp-partial-rst-gpios:
    maxItems: 1
    description: AP2CP_PARTIAL_RST_N; the AP holds this active-low line high
      (deasserted) or MAIN samples it as a partial-reset request and
      self-resets after ONLINE.  Optional.

required:
  - compatible
  - memory-region
  - memory-region-names
  - google,pcie
  - samsung,doorbell-addr
  - cp2ap-wakeup-gpios

additionalProperties: false

examples:
  - |
    #include <dt-bindings/gpio/gpio.h>

    modem {
        compatible = "samsung,s5300-modem";
        memory-region = <&cp_rmem>, <&cp_msi_rmem>;
        memory-region-names = "ipc", "msi";
        firmware-name = "tegu/cp_pbl.bin";
        google,pcie = <&pcie0>;
        samsung,doorbell-addr = <0x14e60000>;
        cp2ap-wakeup-gpios = <&gpa5 1 GPIO_ACTIVE_HIGH>;
    };
```

## Documentation/devicetree/bindings/net/wwan/samsung,s5xxx-modem.yaml
```yaml
# SPDX-License-Identifier: (GPL-2.0-only OR BSD-2-Clause)
%YAML 1.2
---
$id: http://devicetree.org/schemas/net/wwan/samsung,s5xxx-modem.yaml#
$schema: http://devicetree.org/meta-schemas/core.yaml#

title: Samsung Exynos s5300/s5400 Modem (PCIe)

maintainers:
  - Steffen Deusch <steffen@deusch.me>

description: >
  Discrete Samsung Exynos modem companion chip attached over PCIe, as found on
  Google Tensor boards: the s5300 (e.g. tegu) and the s5400 (e.g. komodo).
  The AP stages the first-stage CP bootloader in a DRAM carveout, publishes it
  through a second carveout that doubles as the PCIe MSI target, and completes
  a shared-memory command handshake.

  The modem is a PCI endpoint, so its node goes under the root port it sits
  behind, per pci-bus.yaml. The driver binds to the enumerated device and the
  PCI core attaches this node to it.

properties:
  compatible:
    enum:
      - samsung,s5300-modem
      - samsung,s5400-modem

  reg:
    maxItems: 1

  memory-region:
    minItems: 2
    items:
      - description: IPC shared-memory carveout (boot image staging, command
          words and message queues)
      - description: MSI carveout the CP reports boot progress into
      - description: PKTPROC carveout the CP DMAs downlink packets into

  memory-region-names:
    minItems: 2
    items:
      - const: ipc
      - const: msi
      - const: pktproc

  firmware-name:
    maxItems: 1
    description: First-stage CP bootloader (the BOOT entry of the vendor
      modem image TOC).

  resets:
    items:
      - description: The PCIe link. The CP bootloader drops the link part way
          through its boot and re-requests it over CP2AP_WAKEUP, so asserting
          and deasserting are driven separately with a wait in between.
      - description: Cold power cycle of the CP, so a crashed or self-reset
          baseband is back in its boot ROM.
      - description: Warm reset of the CP with its dump-notify line latched, so
          it comes back running its minidump agent.

  reset-names:
    items:
      - const: link
      - const: cp-cold
      - const: cp-dump

  cp2ap-wakeup-gpios:
    maxItems: 1
    description: CP-driven line signalling the CP is awake / ready to
      re-link.

  cp2ap-active-gpios:
    maxItems: 1
    description: CP2AP_PHONE_ACTIVE; high while the CP runs, a falling edge
      after ONLINE indicates a CP crash.  Optional (crash diagnosis).

  cp-partial-rst-gpios:
    maxItems: 1
    description: AP2CP_PARTIAL_RST_N; the AP holds this active-low line high
      (deasserted) or MAIN samples it as a partial-reset request and
      self-resets after ONLINE.  Optional.

required:
  - compatible
  - memory-region
  - memory-region-names
  - reg
  - resets
  - reset-names
  - cp2ap-wakeup-gpios

additionalProperties: false

examples:
  - |
    #include <dt-bindings/gpio/gpio.h>
    #include <dt-bindings/reset/google,zuma-pcie.h>

    pcie0: pcie {
        #address-cells = <3>;
        #size-cells = <2>;
        device_type = "pci";
        ranges;
        #reset-cells = <1>;

        pcie@0,0 {
            reg = <0x0 0x0 0x0 0x0 0x0>;
            #address-cells = <3>;
            #size-cells = <2>;
            device_type = "pci";
            ranges;

            modem@0,0 {
                compatible = "samsung,s5400-modem";
                reg = <0x0 0x0 0x0 0x0 0x0>;
                memory-region = <&cp_rmem>, <&cp_msi_rmem>;
                memory-region-names = "ipc", "msi";
                firmware-name = "tegu/cp_pbl.bin";
                resets = <&pcie0 ZUMA_PCIE_RESET_LINK>,
                         <&pcie0 ZUMA_PCIE_RESET_CP_COLD>,
                         <&pcie0 ZUMA_PCIE_RESET_CP_DUMP>;
                reset-names = "link", "cp-cold", "cp-dump";
                cp2ap-wakeup-gpios = <&gpa5 1 GPIO_ACTIVE_HIGH>;
            };
        };
    };
```

## Documentation/devicetree/bindings/pci/google,zuma-pcie.yaml
```yaml
# SPDX-License-Identifier: (GPL-2.0-only OR BSD-2-Clause)
%YAML 1.2
---
$id: http://devicetree.org/schemas/pci/google,zuma-pcie.yaml#
$schema: http://devicetree.org/meta-schemas/core.yaml#

title: Google Tensor SoC PCIe Host Controller

maintainers:
  - Trijal Saha <97483939+Trijal08@users.noreply.github.com>

description:
  PCIe host controller found on the Google Tensor SoCs (zuma/zumapro). It is
  based on the Synopsys DesignWare PCIe IP and thus inherits all the common
  properties defined in snps,dw-pcie.yaml. The PHY input clock and the PHY
  isolation are controlled through the PMU system controller.

allOf:
  - $ref: /schemas/pci/snps,dw-pcie.yaml#

properties:
  compatible:
    const: google,zuma-pcie

  reg:
    items:
      - description: External Local Bus Interface (ELBI) registers.
      - description: Data Bus Interface (DBI) registers.
      - description: PCIe configuration space region.

  reg-names:
    items:
      - const: elbi
      - const: dbi
      - const: config

  interrupts:
    maxItems: 1

  clocks:
    minItems: 1
    maxItems: 16

  num-lanes:
    const: 1

  phys:
    maxItems: 1

  phy-names:
    const: pcie-phy

  samsung,pmu-syscon:
    $ref: /schemas/types.yaml#/definitions/phandle
    description:
      Phandle to the PMU system controller, used to enable the PCIE_PHY
      control bit during link bring-up.

  samsung,pmu-offset:
    $ref: /schemas/types.yaml#/definitions/uint32
    description:
      Offset of the PCIE_PHY control register within the PMU system controller.

  samsung,perst-delay-us:
    description:
      Delay in microseconds after deasserting PERST# before link training.
    default: 15000

  reset-gpios:
    maxItems: 1
    description: PERST# reset GPIO driven to the endpoint.

  wlan-reg-on-gpios:
    maxItems: 1
    description:
      Optional power-enable (WLAN_EN / REG_ON) GPIO for a Wi-Fi endpoint.

required:
  - compatible
  - reg
  - reg-names
  - interrupts
  - clocks
  - num-lanes
  - phys
  - phy-names
  - samsung,pmu-syscon
  - samsung,pmu-offset
  - reset-gpios

unevaluatedProperties: false

examples:
  - |
    #include <dt-bindings/interrupt-controller/irq.h>
    #include <dt-bindings/interrupt-controller/arm-gic.h>
    #include <dt-bindings/gpio/gpio.h>

    pcie@13120000 {
        compatible = "google,zuma-pcie";
        reg = <0x13120000 0x2000>,
              <0x13400000 0x381000>,
              <0x60ffe000 0x2000>;
        reg-names = "elbi", "dbi", "config";
        interrupts = <GIC_SPI 439 IRQ_TYPE_LEVEL_HIGH 0>;
        #address-cells = <3>;
        #size-cells = <2>;
        device_type = "pci";
        ranges = <0x82000000 0 0x60000000 0x60000000 0 0x00ff0000>;
        bus-range = <0x00 0xff>;
        num-lanes = <1>;
        clocks = <&cmu_hsi2 0>;
        phys = <&pcie_1_phy>;
        phy-names = "pcie-phy";
        samsung,pmu-syscon = <&pmu_system_controller>;
        samsung,pmu-offset = <0x3ec8>;
        samsung,perst-delay-us = <15000>;
        reset-gpios = <&gph3 0 GPIO_ACTIVE_HIGH>;
        wlan-reg-on-gpios = <&gph3 4 GPIO_ACTIVE_HIGH>;
    };
...
```
